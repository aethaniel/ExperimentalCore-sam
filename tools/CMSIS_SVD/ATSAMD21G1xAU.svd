# ATSAMD21G1xAU register map
Vendor: Atmel Corporation; Series: SAMD21; File version: C
Atmel ATSAMD21G1xAU devices: Cortex-M0+ Microcontrollers
CPU: CM0+ r0p1, little endian, no MPU, no FPU, VTOR, 2 interrupt priority bits
Registers are 8-bit, read-write, reset 0x0 unless marked. A register's access mark holds for its fields unless they carry their own. Offsets are from the block's base; lines under a group give offsets from that group; [hi:lo] are bit positions; {n}, {i} and the like mark numbered series; 'fields as' and 'values as' point back to an identical list; <NAME> marks a mode.

## Memory map
0x40000000 PAC0 size 0x8 — Peripheral Access Controller 0
0x40000400 PM size 0x80 — Power Manager
0x40000800 SYSCTRL size 0x80 — System Control
0x40000C00 GCLK size 0x10 — Generic Clock Generator
0x40001000 WDT size 0x10 — Watchdog Timer
0x40001400 RTC size 0x40 — Real-Time Counter
0x40001800 EIC size 0x40 — External Interrupt Controller
0x41000000 PAC1 size 0x8 — Peripheral Access Controller 1
0x41002000 DSU size 0x2000 — Device Service Unit
0x41004000 NVMCTRL size 0x80 — Non-Volatile Memory Controller
0x41004400 PORT size 0x200 — Port Module
0x41004800 DMAC size 0x80 — Direct Memory Access Controller
0x41005000 USB size 0x1000 — Universal Serial Bus
0x41006000 MTB size 0x1000 — Cortex-M0+ Micro-Trace Buffer
0x41007000 HMATRIX size 0x400 — HSB Matrix
0x42000000 PAC2 size 0x8 — Peripheral Access Controller 2
0x42000400 EVSYS size 0x80 — Event System Interface
0x42000800 SERCOM0 size 0x40 — Serial Communication Interface 0
0x42000C00 SERCOM1 size 0x40 — Serial Communication Interface 1
0x42001000 SERCOM2 size 0x40 — Serial Communication Interface 2
0x42001400 SERCOM3 size 0x40 — Serial Communication Interface 3
0x42001800 SERCOM4 size 0x40 — Serial Communication Interface 4
0x42001C00 SERCOM5 size 0x40 — Serial Communication Interface 5
0x42002000 TCC0 size 0x90 — Timer Counter Control 0
0x42002400 TCC1 size 0x90 — Timer Counter Control 1
0x42002800 TCC2 size 0x90 — Timer Counter Control 2
0x42002C00 TC3 size 0x40 — Basic Timer Counter 3
0x42003000 TC4 size 0x40 — Basic Timer Counter 4
0x42003400 TC5 size 0x40 — Basic Timer Counter 5
0x42003800 TC6 size 0x40 — Basic Timer Counter 6
0x42003C00 TC7 size 0x40 — Basic Timer Counter 7
0x42004000 ADC size 0x80 — Analog Digital Converter
0x42004400 AC size 0x40 — Analog Comparators
0x42004800 DAC size 0x10 — Digital Analog Converter
0x42005000 I2S size 0x40 — Inter-IC Sound Interface

## Interrupts
0 PM
1 SYSCTRL
2 WDT
3 RTC
4 EIC
5 NVMCTRL
6 DMAC
7 USB
8 EVSYS
9 SERCOM0
10 SERCOM1
11 SERCOM2
12 SERCOM3
13 SERCOM4
14 SERCOM5
15 TCC0
16 TCC1
17 TCC2
18 TC3
19 TC4
20 TC5
21 TC6
22 TC7
23 ADC
24 AC
25 DAC
27 I2S

## Licence text in the file
============================================================================ Atmel Microcontroller Software Support ============================================================================ Copyright (c) 2015, Atmel Corporation . All rights reserved. . Redistribution and use in source and binary forms, with or without modification, are permitted provided that the following condition is met: - Redistributions of source code must retain the above copyright notice, this list of conditions and the disclaimer below. . Atmel's name may not be used to endorse or promote products derived from this software without specific prior written permission. . DISCLAIMER: THIS SOFTWARE IS PROVIDED BY ATMEL "AS IS" AND ANY EXPRESS OR. IMPLIED WARRANTIES, INCLUDING, BUT NOT LIMITED TO, THE IMPLIED WARRANTIES OF. MERCHANTABILITY, FITNESS FOR A PARTICULAR PURPOSE AND NON-INFRINGEMENT ARE. DISCLAIMED. IN NO EVENT SHALL ATMEL BE LIABLE FOR ANY DIRECT, INDIRECT, INCIDENTAL, SPECIAL, EXEMPLARY, OR CONSEQUENTIAL DAMAGES (INCLUDING, BUT NOT. LIMITED TO, PROCUREMENT OF SUBSTITUTE GOODS OR SERVICES; LOSS OF USE, DATA, OR PROFITS; OR BUSINESS INTERRUPTION) HOWEVER CAUSED AND ON ANY THEORY OF. LIABILITY, WHETHER IN CONTRACT, STRICT LIABILITY, OR TORT (INCLUDING. NEGLIGENCE OR OTHERWISE) ARISING IN ANY WAY OUT OF THE USE OF THIS SOFTWARE, EVEN IF ADVISED OF THE POSSIBILITY OF SUCH DAMAGE. ============================================================================
